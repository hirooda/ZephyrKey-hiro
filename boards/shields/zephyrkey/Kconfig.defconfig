## boards/shields/zephyrkey/Kconfig.defconfig
```kconfig
if SHIELD_ZEPHYRKEY_RIGHT

config ZMK_KEYBOARD_NAME
    default "zephyrkey"

endif

if SHIELD_ZEPHYRKEY_LEFT || SHIELD_ZEPHYRKEY_RIGHT

config ZMK_SPLIT
    default y

endif
```

## boards/shields/zephyrkey/Kconfig.shield
```kconfig
config SHIELD_ZEPHYRKEY_LEFT
    def_bool $(shields_list_contains,zephyrkey_left)
config SHIELD_ZEPHYRKEY_RIGHT
    def_bool $(shields_list_contains,zephyrkey_right)
```
